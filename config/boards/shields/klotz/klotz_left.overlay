/*
 * Copyright (c) 2022 GEIST
 *
 * SPDX-License-Identifier: MIT
 */

#include "klotz.dtsi"
#include <dt-bindings/zmk/pointing.h>

/ { // <-- 루트 노드 시작

    // &kscan0 노드 정의 (여기서부터 들여쓰기가 시작되어야 합니다.)
    &kscan0 {
        col-gpios
            = <&pro_micro 18 GPIO_ACTIVE_HIGH>
            , <&pro_micro 15 GPIO_ACTIVE_HIGH>
            , <&pro_micro 14 GPIO_ACTIVE_HIGH>
            , <&pro_micro 16 GPIO_ACTIVE_HIGH>
            , <&pro_micro 10 GPIO_ACTIVE_HIGH>
            ;
    };

    // sensors 노드 정의
    sensors {
        compatible = "zmk,keymap-sensors";

        &left_encoder { // klotz.dtsi의 left_encoder를 참조
            status = "okay"; // 왼쪽 절반에서 이 엔코더 활성화
            sensor-bindings = <&inc_dec_kp MRS_SCROLL_DOWN MRS_SCROLL_UP>; // 왼쪽 엔코더 동작
        };
        // right_encoder는 klotz_left.overlay에서는 정의하지 않습니다.
    };

    // ... 다른 왼쪽 쉴드 특정 정의가 있다면 여기에 추가 ...

}; // <-- 루트 노드 끝
