## config/boards/shields/klotz/Kconfig.defconfig
```kconfig
if SHIELD_KLOTZ_DONGLE

config ZMK_KEYBOARD_NAME
    default "KLOTZ"

config ZMK_SPLIT_ROLE_CENTRAL
    default y

config ZMK_USB
    default y

endif

if SHIELD_KLOTZ_LEFT || SHIELD_KLOTZ_RIGHT || SHIELD_KLOTZ_DONGLE

config ZMK_SPLIT
    default y

config ZMK_BLE
    default y

endif

if ZMK_BACKLIGHT

    config PWM
        default y

    config LED_PWM
        default y

endif # ZMK_BACKLIGHT
```

## config/west.yml
```yaml
manifest:
  remotes:
    - name: zmkfirmware
      url-base: https://github.com/zmkfirmware
    - name: janpfischer
      url-base: https://github.com/janpfischer
  projects:
    - name: zmk
      remote: zmkfirmware
      revision: main #or at least 147c340c6e8d377304acfdd64dc86cf83ebdfef2 (see important notice in Installation Guide in the dongle-screen readme)
      import: app/west.yml
    - name: zmk-dongle-screen
      remote: janpfischer
      revision: main
  self:
    path: config
```
